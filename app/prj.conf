## CMakeLists.txt
```
cmake_minimum_required(VERSION 3.20.0)

list(APPEND DTS_ROOT ${CMAKE_CURRENT_SOURCE_DIR})
find_package(Zephyr REQUIRED)
project(my_zephyr_app)

add_subdirectory(drivers/sensor/led_sensor)
target_include_directories(app PRIVATE drivers/sensor/led_sensor)
target_sources(app PRIVATE
  src/main.c
  src/sensor_shell.c
)
```

## Kconfig
```
menuconfig LED_SUBSYSTEM
	bool "LED Subsystem"
	default y
	help
	  Enable the heartbeat LED application.

if LED_SUBSYSTEM

config APP_HEARTBEAT_PERIOD_MS
	int "Heartbeat LED period (ms)"
	range 100 2000
	default 500

menuconfig LED_ADVANCED
	bool "Advanced LED settings"
	default n

if LED_ADVANCED

config LED_BRIGHTNESS
	int "LED brightness (0-100)"
	range 0 100
	default 100

config LED_FADE_DURATION_MS
	int "LED fade duration (ms)"
	range 0 60000
	default 500

menu "Expert settings"

config LED_DEBUG
	bool "Enable LED debugging"
	default n
config LED_CUSTOM_BLINK_PATTERN
	bool "Custom blink pattern"
	default n
endmenu

endif # LED_ADVANCED
endif # LED_SUBSYSTEM

rsource "drivers/sensor/led_sensor/Kconfig"

source "Kconfig.zephyr"
```

## prj.conf
```kconfig
CONFIG_GPIO=y
CONFIG_LOG=y
CONFIG_SENSOR=y
CONFIG_HENRY_LED_SENSOR=y
CONFIG_SHELL=y
# Include the app's extended sensor API in Zephyr's device API metadata.
CONFIG_APPLICATION_DEFINED_SYSCALL=y
```

## app.overlay
```dts
/ {
	aliases {
		app-led = &led0;
	};

	led_sensor: led-sensor {
		compatible = "henry,led-sensor";
		led = <&led0>;
		status = "okay";
	};
};
```

## boards/esp32_devkitc_procpu.overlay
```dts
/ {
	leds {
		compatible = "gpio-leds";

		led0: led_0 {
			gpios = <&gpio0 2 GPIO_ACTIVE_HIGH>;
			label = "External heartbeat LED on GPIO2";
		};
	};

	aliases {
		led0 = &led0;
	};
};

#include "../app.overlay"
```

## dts/bindings/sensor/henry,led-sensor.yaml
```yaml
description: LED controlled through the Zephyr sensor API

compatible: "henry,led-sensor"

include: base.yaml

properties:
  led:
    type: phandle
    required: true
    description: GPIO LED node controlled by this driver
```

## src/main.c
```c
#include <zephyr/device.h>
#include <zephyr/sys/printk.h>

#include "led_sensor.h"

static const struct device *const led_sensor = DEVICE_DT_GET(DT_NODELABEL(led_sensor));

int main(void)
{
	uint32_t period_ms;
	int ret;

	if (!IS_ENABLED(CONFIG_LED_SUBSYSTEM)) {
		return 0;
	}

	if (!device_is_ready(led_sensor)) {
		printk("LED sensor is not ready\n");
		return 0;
	}

	ret = led_sensor_set_period_ms(led_sensor, CONFIG_APP_HEARTBEAT_PERIOD_MS);
	if (ret < 0) {
		printk("LED period update failed: %d\n", ret);
		return 0;
	}
	period_ms = led_sensor_get_period_ms(led_sensor);
	printk("LED period: %u ms\n", period_ms);

	return 0;
}
```

## src/main.cpp
```c
#include <zephyr/device.h>
#include <zephyr/drivers/sensor.h>
#include <zephyr/kernel.h>
#include <zephyr/sys/printk.h>

static const struct device *const led_sensor = DEVICE_DT_GET(DT_NODELABEL(led_sensor));

int main(void)
{
	struct sensor_value value;
	int ret;

	if (!IS_ENABLED(CONFIG_LED_SUBSYSTEM)) {
		return 0;
	}

	if (!device_is_ready(led_sensor)) {
		printk("LED sensor is not ready\n");
		return 0;
	}

	while (true) {
		ret = sensor_sample_fetch(led_sensor);
		if (ret < 0) {
			printk("LED on failed: %d\n", ret);
			return 0;
		}
		printk("LED on\n");
		k_msleep(CONFIG_APP_HEARTBEAT_PERIOD_MS);

		ret = sensor_channel_get(led_sensor, SENSOR_CHAN_LIGHT, &value);
		if (ret < 0) {
			printk("LED off failed: %d\n", ret);
			return 0;
		}
		printk("LED off\n");
		k_msleep(CONFIG_APP_HEARTBEAT_PERIOD_MS);
	}
}
```

## src/sensor_shell.c
```c
#include <zephyr/device.h>
#include <zephyr/drivers/sensor.h>
#include <zephyr/shell/shell.h>
#include <zephyr/shell/shell_string_conv.h>

#include "led_sensor.h"
 
static const struct device *const led_sensor = DEVICE_DT_GET(DT_NODELABEL(led_sensor));

static int cmd_sensor_fetch(const struct shell *sh, size_t argc, char **argv)
{
	int ret;

	ARG_UNUSED(argc);
	ARG_UNUSED(argv);

	if (!device_is_ready(led_sensor)) {
		shell_error(sh, "Sensor device is not ready");
		return -ENODEV;
	}

	ret = sensor_sample_fetch(led_sensor);
	if (ret < 0) {
		shell_error(sh, "sensor_sample_fetch failed: %d", ret);
		return ret;
	}

	shell_print(sh, "Sample fetched");
	return 0;
}

static int cmd_sensor_read(const struct shell *sh, size_t argc, char **argv)
{
	struct sensor_value value;
	int ret;

	ARG_UNUSED(argc);
	ARG_UNUSED(argv);

	if (!device_is_ready(led_sensor)) {
		shell_error(sh, "Sensor device is not ready");
		return -ENODEV;
	}

	ret = sensor_channel_get(led_sensor, SENSOR_CHAN_LIGHT, &value);
	if (ret < 0) {
		shell_error(sh, "sensor_channel_get failed: %d", ret);
		return ret;
	}

	shell_print(sh, "Result: %d.%06d", value.val1, value.val2);
	return 0;
}

static int cmd_sensor_set(const struct shell *sh, size_t argc, char **argv)
{
	unsigned long period_ms;
	int err;
	int ret;

	if (argc != 2) {
		shell_error(sh, "Usage: sensorroot set <period_ms>");
		return -EINVAL;
	}

	period_ms = shell_strtoul(argv[1], 10, &err);
	if (err != 0 || period_ms < 100 || period_ms > 2000) {
		shell_error(sh, "Period must be an integer from 100 to 2000 ms");
		return -EINVAL;
	}

	if (!device_is_ready(led_sensor)) {
		shell_error(sh, "Sensor device is not ready");
		return -ENODEV;
	}

	ret = led_sensor_set_period_ms(led_sensor, (uint32_t)period_ms);
	if (ret < 0) {
		shell_error(sh, "Failed to set period: %d", ret);
		return ret;
	}

	shell_print(sh, "LED period set to %lu ms", period_ms);
	return 0;
}

static int cmd_sensor_info(const struct shell *sh, size_t argc, char **argv)
{
	ARG_UNUSED(argc);
	ARG_UNUSED(argv);

	shell_print(sh, "Device: %s", led_sensor->name);
	shell_print(sh, "Ready: %s", device_is_ready(led_sensor) ? "yes" : "no");
	return 0;
}

SHELL_STATIC_SUBCMD_SET_CREATE(sensorroot_subcommands,
	SHELL_CMD(fetch, NULL, "Call sensor_sample_fetch()", cmd_sensor_fetch),
	SHELL_CMD(read, NULL, "Call sensor_channel_get() and print the result", cmd_sensor_read),
	SHELL_CMD(info, NULL, "Print the sensor device name and ready state", cmd_sensor_info),
	SHELL_CMD_ARG(set, NULL, "Set LED period in milliseconds", cmd_sensor_set, 2, 0),
	SHELL_SUBCMD_SET_END
);

SHELL_CMD_REGISTER(sensorroot, &sensorroot_subcommands, "LED sensor commands", NULL);
```
