## app/drivers/sensor/led_sensor/Kconfig
```kconfig
config HENRY_LED_SENSOR
	bool "Henry LED sensor driver"
	depends on SENSOR && GPIO
	default y if DT_HAS_HENRY_LED_SENSOR_ENABLED
	help
	  Expose a GPIO LED through sensor_sample_fetch and sensor_channel_get.
```

## boards/others/henry-esp32-scratch/board.yml
```yaml
board:
  name: henry-esp32-scratch
  full_name: Henry ESP32 (from scratch)
  vendor: others
  socs:
    - name: esp32
```

## boards/others/henry-esp32-scratch/henry-esp32-scratch_procpu_defconfig
```kconfig
CONFIG_CONSOLE=y
CONFIG_SERIAL=y
CONFIG_UART_CONSOLE=y
CONFIG_GPIO=y
CONFIG_ESP32_USE_UNSUPPORTED_REVISION=y
```

## boards/others/henry-esp32/Kconfig
```kconfig
config HEAP_MEM_POOL_ADD_SIZE_BOARD
	int
	default 4096 if BOARD_HENRY_ESP32_ESP32_PROCPU
```

## boards/others/henry-esp32/board.yml
```yaml
board:
  name: henry-esp32
  full_name: Henry ESP32
  vendor: others
  socs:
  - name: esp32
```
